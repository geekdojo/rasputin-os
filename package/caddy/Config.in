## package/caddy/Config.in
```kconfig
config BR2_PACKAGE_CADDY
	bool "caddy"
	default y
	help
	  Stock Caddy web server (ADR-0004 §7) — the node-local reverse proxy
	  the rasputin-agent runs to front apps: TLS-terminate each app's
	  Mesh-CA leaf and Host-route to its loopback port. Driven entirely via
	  the admin API by the agent; auto-HTTPS is off (Rasputin mints and
	  ships the leaves, never Caddy's ACME).

	  A pre-built pure-Go static release binary (CGO-free, so it runs on the
	  musl userland with no extra deps). See package/caddy/caddy.mk.

	  https://caddyserver.com
```

## package/openbao/Config.in
```kconfig
config BR2_PACKAGE_OPENBAO
	bool "openbao"
	help
	  OpenBao, the node secrets store (ADR-0010, geekdojo/geekdojo-brain
	  #798). This package installs only the pinned upstream release
	  binary as /usr/bin/bao, its MPL-2.0 LICENSE and source notice under
	  /usr/share/licenses/openbao/, and the static openbao service user
	  (uid/gid 990). No unit and no config: nothing starts the binary
	  until the store's unit lands.

	  A pre-built CGO-free release binary, hash-pinned from upstream's
	  GPG- and cosign-verified checksums.txt. See
	  package/openbao/openbao.mk.

	  There is deliberately no architecture "depends on": a target
	  architecture the tarball map in openbao.mk does not know fails the
	  build instead of silently dropping the store from the image.

	  https://openbao.org
```

## package/tailscale-bin/Config.in
```kconfig
config BR2_PACKAGE_TAILSCALE_BIN
	bool "tailscale-bin"
	depends on BR2_aarch64 || BR2_x86_64
	depends on !BR2_PACKAGE_TAILSCALE
	help
	  Tailscale (tailscale + tailscaled), installed from Tailscale's
	  official statically-linked release tarballs at
	  pkgs.tailscale.com/stable rather than built by Buildroot's own
	  tailscale package.

	  EXPERIMENT (spike/own-tailscale): Buildroot 2026.08 pins
	  tailscale 1.78.1 and its install hook turns tailscaled into a
	  self-referencing symlink under BR2_ROOTFS_MERGED_BIN. This
	  package pins its own version and installs into /usr/bin.

	  https://tailscale.com/
```

## spike/957/Config.in
```kconfig
menu "SPIKE ONLY: geekdojo-brain#957 identity runtime"
source "$BR2_EXTERNAL_SPIKE957_PATH/package/temurin-jre/Config.in"
source "$BR2_EXTERNAL_SPIKE957_PATH/package/keycloak/Config.in"
endmenu
```

## spike/957/package/keycloak/Config.in
```kconfig
config BR2_PACKAGE_KEYCLOAK
	bool "keycloak (SPIKE ONLY)"
	depends on BR2_PACKAGE_TEMURIN_JRE
	help
	  Keycloak, built at image build with platform.md §2.3's build
	  options and installed to /usr/lib/keycloak. Spike only.
```

## spike/957/package/temurin-jre/Config.in
```kconfig
config BR2_PACKAGE_TEMURIN_JRE
	bool "temurin-jre (SPIKE ONLY)"
	depends on BR2_aarch64 || BR2_x86_64
	depends on BR2_TOOLCHAIN_USES_GLIBC
	help
	  Eclipse Temurin JRE 25, prebuilt, installed to
	  /usr/lib/temurin-jre (platform.md §2.1). Spike only.
```
