## Config.in
```kconfig
#
# Rasputin OS external tree — Kconfig entry points.
# These appear under "External options" in `make menuconfig`.
#

menu "Rasputin"

source "$BR2_EXTERNAL_RASPUTIN_PATH/package/rasputin-agent/Config.in"
source "$BR2_EXTERNAL_RASPUTIN_PATH/package/rasputin-api/Config.in"

endmenu
```

## configs/rasputin_cm5_defconfig
```kconfig
# Rasputin OS — Raspberry Pi CM5 (arm64, BCM2712).
#
# Derived from Buildroot's Raspberry Pi 5 reference defconfig (same BCM2712
# silicon as the CM5) + HAOS's CM5 config for the firmware/DTB/tryboot bits.
# Plus systemd, squashfs+verity rootfs, Docker, RAUC A/B, Rasputin packages.
#
# This is the image that most wants the real board for final validation:
# the Pi firmware boot flow + the one-shot `tryboot` A/B (no boot-counter)
# can't be fully exercised in QEMU. The bring-up items are flagged below.
# Evolve loop:
#   make BR2_EXTERNAL=$PWD O=output/cm5 rasputin_cm5_defconfig
#   make BR2_EXTERNAL=$PWD O=output/cm5 linux-menuconfig   # then savedefconfig

# --- target arch ---
BR2_aarch64=y
BR2_cortex_a76=y

# --- build: ccache (CI caches ~/.buildroot-ccache across runs; warm rebuilds
# of the kernel + packages drop from hours to minutes — release-pipeline.md §6) ---
BR2_CCACHE=y

# --- toolchain / init / libc ---
BR2_TOOLCHAIN_BUILDROOT_GLIBC=y
BR2_TOOLCHAIN_BUILDROOT_CXX=y
BR2_INIT_SYSTEMD=y
# (no BR2_SYSTEM_DHCP — see rasputin_n100_defconfig: the literal "eth0" match
# never fires under udev predictable naming; the overlay 20-wired.network
# covers en*/eth* on both arches.)
BR2_TARGET_GENERIC_HOSTNAME="rasputin"
BR2_TARGET_GENERIC_ISSUE="Welcome to Rasputin OS"
# Pi serial console (UART on the 40-pin header / debug connector).
BR2_TARGET_GENERIC_GETTY_PORT="ttyAMA0"

# --- kernel: BCM2712 ---
# Use mainline's UNIFIED arm64 config (arch/arm64/configs/defconfig) — it
# carries broad SoC support including BCM2712 (Pi 5 / CM5) in recent
# kernels. NOTE: `bcm2712_defconfig` only exists in the Raspberry Pi kernel
# FORK, not mainline — using it errors with "Can't find default
# configuration". If a peripheral is missing on the real CM5, switch to the
# Pi fork (BR2_LINUX_KERNEL_CUSTOM_GIT → raspberrypi/linux + its
# bcm2712_defconfig); that's the documented bring-up fallback.
# BRING-UP: the DTS below is the Pi 5 B board; swap to the CM5 carrier DTB
# (bcm2712-rpi-cm5-cb / -cm5io) once the carrier is known.
BR2_LINUX_KERNEL=y
BR2_LINUX_KERNEL_LATEST_VERSION=y
BR2_LINUX_KERNEL_USE_ARCH_DEFAULT_CONFIG=y
BR2_LINUX_KERNEL_DTS_SUPPORT=y
BR2_LINUX_KERNEL_INTREE_DTS_NAME="broadcom/bcm2712-rpi-5-b"
BR2_LINUX_KERNEL_CONFIG_FRAGMENT_FILES="$(BR2_EXTERNAL_RASPUTIN_PATH)/board/rasputin/cm5/linux.fragment"
BR2_LINUX_KERNEL_NEEDS_HOST_OPENSSL=y

# --- RPi firmware (the bootloader on Pi; tryboot A/B lives here) ---
BR2_PACKAGE_RPI_FIRMWARE=y
# BRING-UP: confirm the Pi 5 firmware variant + the exact blob set genimage
# needs in the FAT partition (Pi 5 boots via the EEPROM bootloader → config.txt
# → kernel; the tryboot one-shot flag is the A/B mechanism). See
# os-images/buildroot-os.md §3 and HAOS PR #3842.

# --- A/B + RAUC ---
# real e2fsprogs: systemd-makefs execs mkfs.ext4; busybox mke2fs cannot
# answer to that name (see rasputin_n100_defconfig)
BR2_PACKAGE_E2FSPROGS=y
BR2_PACKAGE_RAUC=y
BR2_PACKAGE_HOST_RAUC=y
BR2_PACKAGE_SQUASHFS=y
BR2_PACKAGE_CRYPTSETUP=y          # veritysetup for dm-verity at runtime

# --- host tools for image assembly (post-image.sh) ---
BR2_PACKAGE_HOST_GENIMAGE=y
BR2_PACKAGE_HOST_DOSFSTOOLS=y
BR2_PACKAGE_HOST_MTOOLS=y

# --- app primitive ---
BR2_PACKAGE_DOCKER_ENGINE=y
BR2_PACKAGE_DOCKER_CLI=y

# --- Rasputin packages (this external tree) ---
BR2_PACKAGE_RASPUTIN_AGENT=y
BR2_PACKAGE_RASPUTIN_API=y

# --- rootfs: squashfs (read-only, verity-friendly) ---
BR2_TARGET_ROOTFS_SQUASHFS=y
BR2_TARGET_ROOTFS_SQUASHFS4_XZ=y

# --- overlay + hooks (shared across both arches) ---
BR2_ROOTFS_OVERLAY="$(BR2_EXTERNAL_RASPUTIN_PATH)/board/rasputin/common/rootfs-overlay"
BR2_ROOTFS_POST_BUILD_SCRIPT="$(BR2_EXTERNAL_RASPUTIN_PATH)/board/rasputin/common/post-build.sh"
BR2_ROOTFS_POST_IMAGE_SCRIPT="$(BR2_EXTERNAL_RASPUTIN_PATH)/board/rasputin/common/post-image.sh"
BR2_ROOTFS_POST_SCRIPT_ARGS="cm5"
```

## configs/rasputin_n100_defconfig
```kconfig
# Rasputin OS — LattePanda Mu / Intel N100 (amd64).
#
# Derived from Buildroot's pc_x86_64_efi reference config (generic x86_64
# UEFI — boots in QEMU and on the N100 alike), plus systemd, squashfs+verity
# rootfs, Docker, RAUC A/B, and the Rasputin packages.
#
# Reference-grounded STARTER, not a finished BSP. The first `make` + QEMU
# boot will surface gaps (Buildroot prints a kernel-config checklist for
# Docker; board-specific drivers get tuned on real hardware). Evolve loop:
#   make BR2_EXTERNAL=$PWD O=output/n100 rasputin_n100_defconfig
#   make BR2_EXTERNAL=$PWD O=output/n100 linux-menuconfig   # then savedefconfig

# --- target arch ---
BR2_x86_64=y
BR2_x86_corei7=y

# --- build: ccache (CI caches ~/.buildroot-ccache across runs; warm rebuilds
# of the kernel + packages drop from hours to minutes — release-pipeline.md §6) ---
BR2_CCACHE=y

# --- toolchain / init / libc ---
BR2_TOOLCHAIN_BUILDROOT_GLIBC=y
BR2_TOOLCHAIN_BUILDROOT_CXX=y
BR2_INIT_SYSTEMD=y
# (no BR2_SYSTEM_DHCP: it generates a networkd match on the literal name
# "eth0", which never matches once udev's predictable naming renames the
# NIC — enp1s0 on the Mu, enp0s2 in QEMU. The overlay ships
# etc/systemd/network/20-wired.network matching en*/eth* instead.
# Found on the first Mu bring-up, 2026-06-09.)
# Baked hostname is a deliberately-colliding-with-nothing PLACEHOLDER, not
# "rasputin": every node ships this same squashfs, and systemd-resolved
# (mDNS responder) starts announcing <hostname>.local well before the
# per-role rasputin-hostname.service can run (it waits on the persistent
# mount). If the placeholder were "rasputin", every compute node would
# transiently hijack rasputin.local on every boot. rasputin-hostname.service
# promotes role==controlplane to the transient hostname "rasputin"; other
# roles get their node id.
BR2_TARGET_GENERIC_HOSTNAME="rasputin-node"
BR2_TARGET_GENERIC_ISSUE="Welcome to Rasputin OS"
# systemd logs + a getty on the serial console so QEMU (and a real serial
# cable) can watch boot. The QEMU smoke job greps this output.
BR2_TARGET_GENERIC_GETTY_PORT="ttyS0"
# networkd + resolved are Buildroot defaults (=y) but the image now
# FUNCTIONALLY depends on both: 20-wired.network (DHCP + per-link mDNS) and
# resolved's mDNS responder for rasputin.local (first-run WebAuthn flow).
# Pinned explicitly so a Buildroot default flip can't silently drop them.
# (Buildroot 2025.02.3 ships systemd 256.7, built with default-mdns=yes.)
BR2_PACKAGE_SYSTEMD_NETWORKD=y
BR2_PACKAGE_SYSTEMD_RESOLVED=y

# --- kernel: arch default config + Rasputin fragment ---
# LATEST_VERSION tracks Buildroot's tested default for this release; pin a
# specific LTS (e.g. 6.12.x) for a real release. The arch default carries
# the common x86 drivers (AHCI/NVMe/e1000e/igc/xhci/EFI); the fragment adds
# what our rootfs model needs (squashfs, dm-verity, overlay, virtio for
# QEMU, Intel TCO watchdog, Docker essentials).
BR2_LINUX_KERNEL=y
BR2_LINUX_KERNEL_LATEST_VERSION=y
BR2_LINUX_KERNEL_USE_ARCH_DEFAULT_CONFIG=y
BR2_LINUX_KERNEL_CONFIG_FRAGMENT_FILES="$(BR2_EXTERNAL_RASPUTIN_PATH)/board/rasputin/n100/linux.fragment"
BR2_LINUX_KERNEL_NEEDS_HOST_OPENSSL=y
# x86_64 enables the ORC unwinder, so the kernel builds objtool as a host
# tool — and objtool #includes <gelf.h>. Pull host-elfutils/libelf in (the
# arm64/CM5 kernel doesn't build objtool, so its defconfig omits this).
BR2_LINUX_KERNEL_NEEDS_HOST_LIBELF=y

# --- bootloader: GRUB2 (UEFI) — real boot-attempts counter via grubenv ---
BR2_TARGET_GRUB2=y
BR2_TARGET_GRUB2_X86_64_EFI=y

# --- persistent partition: real e2fsprogs for systemd-makefs ---
# busybox's mke2fs is ext2-only and doesn't answer to "mkfs.ext4" ("applet
# not found"), which systemd-makefs execs — the x-systemd.makefs fstab path
# needs the real tools (caught on 2026.06.0-dev.2).
BR2_PACKAGE_E2FSPROGS=y

# --- A/B + RAUC ---
BR2_PACKAGE_RAUC=y
BR2_PACKAGE_HOST_RAUC=y
BR2_PACKAGE_SQUASHFS=y
BR2_PACKAGE_CRYPTSETUP=y          # veritysetup for dm-verity at runtime

# --- host tools for image assembly (post-image.sh) ---
BR2_PACKAGE_HOST_GENIMAGE=y
BR2_PACKAGE_HOST_DOSFSTOOLS=y
BR2_PACKAGE_HOST_MTOOLS=y

# --- app primitive ---
BR2_PACKAGE_DOCKER_ENGINE=y
BR2_PACKAGE_DOCKER_CLI=y
# tailscale: mesh / remote access (Headscale self-hosted control server). The
# agent autodetects the binary via PATH and drives `tailscale up`; tailscaled
# trusts the per-installation Mesh CA via SSL_CERT_FILE (see the tailscaled
# drop-in in the overlay).
BR2_PACKAGE_TAILSCALE=y

# --- Rasputin packages (this external tree) ---
BR2_PACKAGE_RASPUTIN_AGENT=y
BR2_PACKAGE_RASPUTIN_API=y

# --- rootfs: squashfs (read-only, verity-friendly) ---
BR2_TARGET_ROOTFS_SQUASHFS=y
BR2_TARGET_ROOTFS_SQUASHFS4_XZ=y

# --- overlay + hooks (shared across both arches) ---
BR2_ROOTFS_OVERLAY="$(BR2_EXTERNAL_RASPUTIN_PATH)/board/rasputin/common/rootfs-overlay"
BR2_ROOTFS_POST_BUILD_SCRIPT="$(BR2_EXTERNAL_RASPUTIN_PATH)/board/rasputin/common/post-build.sh"
BR2_ROOTFS_POST_IMAGE_SCRIPT="$(BR2_EXTERNAL_RASPUTIN_PATH)/board/rasputin/common/post-image.sh"
BR2_ROOTFS_POST_SCRIPT_ARGS="n100"
```
